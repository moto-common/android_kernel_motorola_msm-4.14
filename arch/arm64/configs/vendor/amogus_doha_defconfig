## drivers/input/touchscreen/focaltech_0flash_mmi_doha/Kconfig
```kconfig
#
# Focaltech Touchscreen driver configuration
#

config TOUCHSCREEN_FTS_0FLASH_MMI_DOHA
	tristate "Moto FT8719 Touchscreen"
	depends on SPI
	default n
	help
	  Say Y here if you have Moto Focaltech touch panel.
	  If unsure, say N.

config TOUCHSCREEN_FTS_0FLASH_MMI_DOHA_ENABLE_DOUBLE_TAP
	bool "Moto FT8719 Double tap"
	depends on TOUCHSCREEN_FTS_0FLASH_MMI_DOHA
	default n
	help
	  Say Y here to enable support for double tap functionality on Focaltech touch panel.
	  If unsure, say N.
```

## drivers/input/touchscreen/ilitek_0flash_mmi/Kconfig
```kconfig
#
# Ilitek touchscreen driver configuration
#
config TOUCHSCREEN_ILITEK_CHIPSET_0FLASH
	tristate "TOUCHSCREEN_ILITEK CHIPSET"
	help
	  Say Y here if you have a Ilitek CHIPSET touchscreen.
	  ELAN controllers are multi touch controllers which can
	  report 10 touches at a time.

	  If unusre, say N.

config INPUT_ILI_0FLASH_MMI_ENABLE_DOUBLE_TAP
	bool "Moto Ilitek Doubel tap"
	depends on TOUCHSCREEN_ILITEK_CHIPSET_0FLASH
	default n
	help
	  Say Y here if you want to have Double tap support on Moto Ilitek.

	  If unsure, say N.

config INPUT_ILI_PANEL_NOTIFICATIONS
	bool "Moto Ilitek panel notification"
	depends on TOUCHSCREEN_ILITEK_CHIPSET_0FLASH
	default n
	help
	  Say Y here if you want to have panel notification support on Moto Ilitek.

	  If unsure, say N.

config ILITEK_RESUME_BY_DDI
	bool "Moto Ilitek firmware by display"
	depends on TOUCHSCREEN_ILITEK_CHIPSET_0FLASH
	default n
	help
	  Say Y here if you want to firmware by display support on Moto Ilitek.

	  If unsure, say N.
```

## drivers/misc/pen/Kconfig
```kconfig
config BU520XX_PEN
	tristate "BU520XX_PEN HALL Sensor support"
	help
	   Select this device if you have a BU520XX HALL Sensor
	   Compatible device.
```

## drivers/pinctrl/cirrus/Kconfig
```kconfig
config PINCTRL_MADERA
	bool
	select PINMUX
	select GENERIC_PINCONF
	default y if MFD_MADERA=y

config PINCTRL_TACNA
	tristate "Cirrus Tacna Pinctrl"
	select PINMUX
	select GENERIC_PINCONF

config PINCTRL_CS47L35
	bool

config PINCTRL_CS48L32
	bool
```

## drivers/power/max17055/Kconfig
```kconfig
config MAX17055_BATTERY_MMI
        tristate "MAX17055"
        default n
        help
         Say Y here if you have a MAX17055 compatible
         device connected.
```
